## userpatches/pcduino3b-nand-boot.its
```
/dts-v1/;

/ {
	description = "pcDuino3B NAND boot FIT";
	#address-cells = <1>;

	images {
		kernel-1 {
			description = "Armbian Linux kernel";
			data = /incbin/("zImage");
			type = "kernel";
			arch = "arm";
			os = "linux";
			compression = "none";
			load = <0x42000000>;
			entry = <0x42000000>;

			hash-1 {
				algo = "sha256";
			};
		};

		ramdisk-1 {
			description = "Armbian initramfs";
			data = /incbin/("initrd.img");
			type = "ramdisk";
			arch = "arm";
			os = "linux";
			/* The gzip stream is passed through for Linux to unpack. */
			compression = "none";
			load = <0x43400000>;

			hash-1 {
				algo = "sha256";
			};
		};

		fdt-1 {
			description = "LinkSprite pcDuino3B NAND runtime DTB";
			data = /incbin/("pcduino3b-nand-runtime.dtb");
			type = "flat_dt";
			arch = "arm";
			compression = "none";
			load = <0x43000000>;

			hash-1 {
				algo = "sha256";
			};
		};
	};

	configurations {
		default = "conf-1";

		conf-1 {
			description = "pcDuino3B NAND rootfs";
			compatible = "linksprite,pcduino3";
			kernel = "kernel-1";
			ramdisk = "ramdisk-1";
			fdt = "fdt-1";
		};
	};
};
```
